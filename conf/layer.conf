## conf/layer.conf
```bitbake
# We have a conf and classes directory, add to BBPATH
BBPATH .= ":${LAYERDIR}"

# We have recipes-* directories, add to BBFILES
BBFILES += "${LAYERDIR}/recipes-*/*/*.bb \
         ${LAYERDIR}/recipes-*/*/*.bbappend"

BBFILE_COLLECTIONS += "basler-imx8"
BBFILE_PATTERN_basler-imx8 = "^${LAYERDIR}/"
BBFILE_PRIORITY_basler-imx8 = "50"
LAYERVERSION_basler-imx8 = "1"
LAYERSERIES_COMPAT_basler-imx8 = "honister kirkstone"

LICENSE_PATH += "${LAYERDIR}/licenses"

PREFERRED_VERSION:isp-imx                 = "4.2.2.17.0"
PREFERRED_VERSION:basler-camera           = "4.2.2.17.0"
PREFERRED_VERSION:kernel-module-isp-vvcam = "4.2.2.17.0"
```
